## config/west.yml
```yaml
manifest:
  projects:
    - name: zmk
      url: https://github.com/sayu-hub/zmk.git
      revision: v0.3-branch
      import: app/west.yml
  self:
    path: config
    
```
